## agltask/conf/layer.conf
```bitbake
# We have a conf and classes directory, add to BBPATH
BBPATH =. "${LAYERDIR}:"

# We have recipes-* directories, add to BBFILES

BBFILES += "${LAYERDIR}/recipes-*/*/*.bb \
            ${LAYERDIR}/recipes-*/*/*.bbappend"

BBFILE_COLLECTIONS += "agltask"
BBFILE_PATTERN_agltask = "^${LAYERDIR}/"
BBFILE_PRIORITY_agltask = "5"

LAYERSERIES_COMPAT_agltask = "scarthgap"

# This should only be incremented on significant changes that will
# cause compatibility issues with other layers
#LAYERVERSION_agltask = "3"

LAYERDEPENDS_agltask = "core"

#REQUIRED_POKY_BBLAYERS_CONF_VERSION = "2"
```

## meta-agltask/conf/layer.conf
```bitbake
# We have a conf and classes directory, add to BBPATH
BBPATH =. "${LAYERDIR}:"

BB_STRICT_CHECKSUM = "0"
BB_STRICT_CHECKSUM:forcevariable = "0"

# We have recipes-* directories, add to BBFILES
BBFILES += "${LAYERDIR}/recipes-*/*/*.bb \
            ${LAYERDIR}/recipes-*/*/*.bbappend"

BBFILE_COLLECTIONS += "meta-agltask"
BBFILE_PATTERN_meta-agltask = "^${LAYERDIR}/"
BBFILE_PRIORITY_meta-agltask = "6"

LAYERSERIES_COMPAT_meta-agltask = "scarthgap"

# This should only be incremented on significant changes that will
# cause compatibility issues with other layers
LAYERVERSION_meta-agltask = "3"

#LAYERDEPENDS_yocto = "core"

#REQUIRED_POKY_BBLAYERS_CONF_VERSION = "2"
```
